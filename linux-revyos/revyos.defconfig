## linux-revyos/revyos.defconfig
```kconfig
# debian_defconfig
CONFIG_SENSORS_PWM_FAN=m
CONFIG_DWMAC_EIC7700=m
CONFIG_DRM_THEAD_TH1520_DW_HDMI=m
CONFIG_SND_SOC_K1_I2S=m
CONFIG_PHY_SPACEMIT_K1_USB2=m
CONFIG_ARCH_ULTRARISC=y
CONFIG_PCIE_ULTRARISC=m
CONFIG_SENSORS_COREPVT_ULTRARISC=m
# spacemit,k1-qspi
CONFIG_SPI_FSL_QUADSPI=m
# doesn't build with =m
CONFIG_PINCTRL_ULTRARISC_DP1000=y
CONFIG_SPACEMIT_K1_TSENSOR=m
# thead,th1520-dc8200 / verisilicon,dc
CONFIG_DRM_VERISILICON_DC=m
CONFIG_SPACEMIT_K3_CCU=m
CONFIG_CRYPTO_AES_RISCV64=m
CONFIG_CRYPTO_GHASH_RISCV64=m
CONFIG_DMA_NUMA_CMA=y
CONFIG_PWM_TH1520=m
```

## linux-sophgo/sophgo.defconfig
```kconfig
# From normal defconfig
CONFIG_PCIE_CADENCE_PLAT_HOST=y
CONFIG_SENSORS_PWM_FAN=m
# From debian debconfig of RevyOS tree (6.15.y)
CONFIG_PCIE_SG2042=y
CONFIG_PCIE_SG2042_HACK=y
CONFIG_PINCTRL_SOPHGO_SG2042=y
CONFIG_PWM_SOPHGO_SG2042=m
CONFIG_SOPHGO_SG2042_MSI=y
CONFIG_CLK_SOPHGO_SG2042_PLL=y
CONFIG_CLK_SOPHGO_SG2042_CLKGEN=y
CONFIG_SPI_SG2044_NOR=m
```

## linux-th1520/th1520.defconfig
```kconfig
# revyos_defconfig
CONFIG_RISCV_THEAD_LIGHT_CPUFREQ=m
CONFIG_DWMAC_THEAD=m
CONFIG_PWM_THEAD=m
CONFIG_LIGHT_AON_PD=y
CONFIG_CLK_LIGHT_FM=y
CONFIG_SENSORS_PWM_FAN=m
CONFIG_CPU_THERMAL=y
CONFIG_USB_DWC3_HOST=y
CONFIG_USB_MUSB_HOST=y
CONFIG_USB_ONBOARD_HUB=m
# Must be builtin because it can't be automatically loaded as a module
CONFIG_LIGHT_PMIC_WATCHDOG=y
# Must be builtin because UART need it
# https://github.com/revyos/th1520-linux-kernel/issues/5
CONFIG_PINCTRL_TH1520=y
# Must be builtin because build failed as module
CONFIG_RPMSG=y
CONFIG_RPMSG_VIRTIO=y
CONFIG_RPMSG_THEAD_LIGHT=y
# from device tree
CONFIG_DW_APB_TIMER_OF=y
CONFIG_MMC_SDHCI_OF_DWCMSHC=m
CONFIG_DW_AXI_DMAC=m
CONFIG_USB_ONBOARD_HUB=m
```

## riscv.defconfig
```kconfig
# StarFive board support
CONFIG_ARCH_STARFIVE=y
CONFIG_SOC_STARFIVE=y
# VisionFive 2
CONFIG_HW_RANDOM_JH7110=m
CONFIG_MMC_DW_STARFIVE=m
CONFIG_SND_SOC_JH7110_TDM=m
CONFIG_SND_SOC_JH7110_PWMDAC=m
CONFIG_USB_CDNS3_STARFIVE=m
CONFIG_CRYPTO_DEV_JH7110=m
CONFIG_SENSORS_SFCTEMP=m
CONFIG_PHY_STARFIVE_JH7110_DPHY_RX=m
CONFIG_PHY_STARFIVE_JH7110_DPHY_TX=m
CONFIG_PHY_STARFIVE_JH7110_PCIE=m
CONFIG_PHY_STARFIVE_JH7110_USB=m
CONFIG_PCIE_STARFIVE_HOST=m
CONFIG_STARFIVE_STARLINK_CACHE=y
CONFIG_VIDEO_STARFIVE_CAMSS=m
CONFIG_AMBA_PL08X=y
CONFIG_CRYPTO_DEV_JH7110=m
CONFIG_STARFIVE_STARLINK_PMU=y
CONFIG_SPI_CADENCE_QUADSPI=m
CONFIG_SPI_PL022=m
# SiFive board support
CONFIG_ARCH_SIFIVE=y
CONFIG_GPIO_SIFIVE=y
CONFIG_SERIAL_SIFIVE=y
CONFIG_SERIAL_SIFIVE_CONSOLE=y
CONFIG_SIFIVE_CCACHE=y
CONFIG_EDAC_SIFIVE=y
CONFIG_PCIE_FU740=y
CONFIG_PWM_SIFIVE=m
CONFIG_REGULATOR_DA9063=m
CONFIG_I2C_HID_CORE=m
CONFIG_I2C_HID=m
CONFIG_I2C_HID_OF_ELAN=m
CONFIG_I2C_HID_OF_GOODIX=m
CONFIG_I2C_HID_OF=m
# ESWIN board support
CONFIG_ARCH_ESWIN=y
CONFIG_PINCTRL_EIC7700=m
# THead board support
CONFIG_ARCH_THEAD=y
CONFIG_ERRATA_THEAD=y
CONFIG_THEAD_TH1520_MBOX=m
CONFIG_PINCTRL_TH1520=m
CONFIG_DWMAC_THEAD=m
CONFIG_TH1520_AON_PROTOCOL=m
CONFIG_TH1520_PM_DOMAINS=m
CONFIG_POWER_SEQUENCING_TH1520_GPU=m
CONFIG_POWER_RESET_TH1520_AON=m
CONFIG_RESET_TH1520=m
# PolarFire board support
CONFIG_ARCH_MICROCHIP=y
CONFIG_PCIE_MICROCHIP_HOST=y
CONFIG_PCIE_XILINX=y
CONFIG_SERIAL_OF_PLATFORM=y
CONFIG_USB_MUSB_POLARFIRE_SOC=m
CONFIG_RTC_DRV_POLARFIRE_SOC=m
CONFIG_POLARFIRE_SOC_MAILBOX=m
CONFIG_I2C_MICROCHIP_CORE=m
CONFIG_POLARFIRE_SOC_SYS_CTRL=m
CONFIG_HW_RANDOM_POLARFIRE_SOC=m
CONFIG_PWM_MICROCHIP_CORE=m
CONFIG_POLARFIRE_SOC_AUTO_UPDATE=m
CONFIG_SPI_POLARFIRE_SOC=m
CONFIG_DW_AXI_DMAC=m
CONFIG_MMC_SDHCI_CADENCE=m
CONFIG_MMC_SDHCI_OF_DWCMSHC=m
CONFIG_GPIO_POLARFIRE_SOC=y
CONFIG_MCHP_SBI_IPC_MBOX=m
# Sophgo board support
CONFIG_ARCH_SOPHGO=y
CONFIG_SOPHGO_SG2042_MSI=y
CONFIG_CLK_SOPHGO_CV1800=m
CONFIG_CLK_SOPHGO_SG2042_PLL=m
CONFIG_CLK_SOPHGO_SG2042_CLKGEN=m
CONFIG_CLK_SOPHGO_SG2042_RPGATE=m
CONFIG_CLK_SOPHGO_SG2044=m
CONFIG_CLK_SOPHGO_SG2044_PLL=m
CONFIG_SENSORS_SG2042_MCU=m
CONFIG_PHY_SOPHGO_CV1800_USB2=m
CONFIG_PINCTRL_SOPHGO_CV1800B=m
CONFIG_PINCTRL_SOPHGO_CV1812H=m
CONFIG_PINCTRL_SOPHGO_SG2042_OPS=y
CONFIG_PINCTRL_SOPHGO_SG2042=m
CONFIG_PINCTRL_SOPHGO_SG2044=m
CONFIG_PINCTRL_SOPHGO_SG2000=m
CONFIG_PINCTRL_SOPHGO_SG2002=m
CONFIG_PWM_SOPHGO_SG2042=m
CONFIG_SPI_SG2044_NOR=m
CONFIG_SOPHGO_CV1800B_ADC=m
CONFIG_SOPHGO_CV1800B_DMAMUX=m
CONFIG_CV1800_MBOX=m
CONFIG_SOPHGO_CV1800_RTCSYS=m
CONFIG_SOPHGO_SG2044_TOPSYS=m
CONFIG_PCIE_SG2042_HOST=m
CONFIG_PCIE_SOPHGO_DW=y
CONFIG_RTC_DRV_CV1800=m
# Canaan Kendryte support
CONFIG_ARCH_CANAAN=y
CONFIG_PINCTRL_K230=y
CONFIG_RESET_K230=m
# Spacemit support
CONFIG_ARCH_SPACEMIT=y
CONFIG_I2C_K1=m
CONFIG_PINCTRL_SPACEMIT_K1=y
CONFIG_SPACEMIT_CCU=m
CONFIG_SPACEMIT_K1_CCU=m
CONFIG_GPIO_SPACEMIT_K1=m
CONFIG_MMC_SDHCI_OF_K1=m
CONFIG_PWM_PXA=m
# QEMU support
CONFIG_ARCH_VIRT=y
CONFIG_PCI_HOST_GENERIC=m
CONFIG_MMC_DW_PLTFM=m
CONFIG_MMC_DW=m
# Allwinner D1 support
CONFIG_ARCH_SUNXI=y
CONFIG_SUN8I_DE2_CCU=m
CONFIG_KEYBOARD_SUN4I_LRADC=m
CONFIG_I2C_MV64XXX=m
CONFIG_SPI_SUN6I=m
# watchdog needs to be initialized early to avoid rebooting (default timeout is 16s set by uboot)
CONFIG_SUNXI_WATCHDOG=y
CONFIG_DRM_SUN4I=m
CONFIG_USB_MUSB_SUNXI=m
CONFIG_MMC_SUNXI=m
CONFIG_RTC_DRV_SUN6I=y
CONFIG_DMA_SUN6I=m
CONFIG_SUN50I_IOMMU=y
CONFIG_PHY_SUN4I_USB=m
CONFIG_NVMEM_SUNXI_SID=m
CONFIG_SUN8I_THERMAL=m
CONFIG_STAGING=y
CONFIG_STAGING_MEDIA=y
CONFIG_VIDEO_SUNXI=y
CONFIG_VIDEO_SUNXI_CEDRUS=m
CONFIG_SND_SUN4I_CODEC=m
CONFIG_SND_SUN4I_I2S=m
CONFIG_SND_SUN4I_SPDIF=m
CONFIG_HWSPINLOCK_SUN6I=y
CONFIG_CRYPTO_DEV_SUN8I_CE=m
CONFIG_CRYPTO_DEV_SUN8I_CE_HASH=y
CONFIG_CRYPTO_DEV_SUN8I_CE_PRNG=y
CONFIG_CRYPTO_DEV_SUN8I_CE_TRNG=y
CONFIG_SUN20I_PPU=y
CONFIG_SND_SUN50I_DMIC=m
CONFIG_SUN20I_GPADC=m
CONFIG_REGULATOR_SUN20I=m
# Others
CONFIG_POWER_RESET_GPIO=y
CONFIG_POWER_RESET_GPIO_RESTART=y
CONFIG_SERIAL_EARLYCON_RISCV_SBI=y
CONFIG_SERIAL_8250_DW=y
CONFIG_ACPI_CPPC_CPUFREQ=m
CONFIG_CPUFREQ_DT=m
CONFIG_CPU_THERMAL=y
# For RISC-V ACLINT-SSWI devices
CONFIG_ACLINT_SSWI=y
# Many uboot doesn't enable zstd support
CONFIG_KERNEL_ZSTD=n
CONFIG_KERNEL_GZIP=y
# Some riscv devices may use IMG GPU
CONFIG_DRM_POWERVR=m
```
